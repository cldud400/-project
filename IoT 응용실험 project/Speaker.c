#include	<avr/io.h>
#include	<avr/interrupt.h>

//#define _MAIN

#define		EX_LED		(*(volatile unsigned char*) 0x8008)

extern void 			initDevices(void);
extern void				printLcd(int row, int col, char *str);

extern unsigned char	musicKey;
extern unsigned char    on;
extern unsigned char    Speaker;
extern unsigned char    music;
extern unsigned int     musicScale[];
extern unsigned char    Message;
extern unsigned char    reci;
extern unsigned char    stop;
extern unsigned char    ds;
extern short			sm1Speed;


extern char t[];




#ifdef	_MAIN
int main(void)
{
	initDevices();
	while(1);
}
#endif

static unsigned char	soundofmusic[] = {
	0x04, 0x12, 0x24, 0x02, 0x24, 0x04, 0x24, 0x14, 0x22, 0x32, 0x32, 0x22, 0x12, 0x38,
	0x24, 0x32, 0x44, 0x22, 0x44, 0x24, 0x44, 0x34, 0x42, 0x52, 0x52, 0x42, 0x32, 0x58,
	0x44, 0x02, 0x12, 0x22, 0x32, 0x42, 0x58, 0x54, 0x12, 0x22, 0x92, 0x42, 0x52, 0x68,
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	0x32, 0x42, 0x52, 0x62, 0x74, 0x44, 0x78
	};

static unsigned char  powerup[] = {
	0x34, 0xb2, 0x52, 0x44, 0x52, 0x32, 0xb2, 0x34, 0x52, 0x42, 0x52, 0x42, 0x32,
	0x14, 0xb2, 0x32, 0x24, 0x32, 0x12, 0xb2, 0x14, 0x32, 0x22, 0x42, 0x32, 0x02,
	0x34, 0xb2, 0x52, 0x44, 0x52, 0x32, 0xb2, 0x34, 0x52, 0x42, 0x52, 0x42, 0x32,
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	0x74, 0x74, 0x94, 0x94, 0xa4, 0xa4, 0xa4, 0xb4
	};


static unsigned char  cityofstar[] = {
	0x12,0x22,0x32,0x52,0x54,0x54,0xb4,0x62,0x72,0x52,0x62,0x42,0x52,
	0x24,0x24,0x24,0x24,0xb4,0xb4,0xb4,0xb4,0x12,0x22,0x32,0x52,0x54,
	0x54,0xb4,0x62,0x72,0x52,0x62,0x42,0x52,0x24,0x24,0x24,0x24,0xb4,
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	0x82,0x74,0x74,0x54,0x54,0x54,0xb4,0xb4,0xb4,0xb4	
	};

static unsigned char	londonsong[] = {
	0x44, 0x54, 0x44, 0x34, 0x24, 0x34, 0x48, 0x14, 0x24, 0x38, 0x24, 0x34, 0x48,
	0x44, 0x54, 0x44, 0x34, 0x24, 0x34, 0x48, 0x18, 0x48, 0x24, 0x04, 0x04, 0xb4,
	0x44, 0x54, 0x44, 0x34, 0x24, 0x34, 0x48, 0x14, 0x24, 0x38, 0x24, 0x34, 0x48,
	0x44, 0x54, 0x44, 0x34, 0x24, 0x34, 0x48, 0x18, 0x48, 0x24, 0x04, 0x04, 0xb4,
	0x44, 0x54, 0x44, 0x34, 0x24, 0x34, 0x48, 0x14, 0x24, 0x38, 0x24, 0x34, 0x48,
	0x44, 0x54, 0x44, 0x34, 0x24, 0x34, 0x48, 0x18, 0x48, 0x24, 0x04, 0x04, 0xb4
};

unsigned char			musicNote = 0;
static unsigned int		noteLength = 0;
static unsigned char	chatter = 0;
static unsigned int		temm = 0;
void
playMusic(void)
{	
	chatter++;
	chatter %= 200;
	if(PINB & 0x80 && !chatter) {
	     
		 on = (on + 1) % 2;
		 
		 
		 if(Speaker) Speaker = 0;
		 if(ds) ds = 0;
		 if(reci) reci = 0;
		 if(music) music = 0;
		 if(Message) Message = 0;
		 printLcd(1, 1, t);
		 printLcd(1, 1, t);
		 stop = 0;
		 
	}
	else if(PINB & 0x40 && !chatter) {
		Message = (Message + 1) % 2;
        if(reci) reci = 0;
	}

	else if(PINB & 0x20) {
	    if(!chatter) {
			sm1Speed++;
			ds++;
	       	if(ds > 5) ds = 5;
			if(sm1Speed >= 6) sm1Speed = 5;
		}
	}
	else if(PINB & 0x10){
		if(!chatter) {
		    sm1Speed--;
			ds--;
			if(ds <= 0) ds = 1;
			if(sm1Speed <= 0) sm1Speed = 1;
		}
	}
	 
	else if(PINB & 0x08&& !chatter) {
		Speaker = (Speaker + 1) % 2;
		music = 1;
	}
	else if(PINB & 0x04 && !chatter) {
	     music = music + 1;
		 musicNote = 0;
		 if(music >= 5) music = 1;
		 }
	else if(PINB & 0x02 && !chatter) {
	     music = music - 1;
		 musicNote = 0;
		 if(music <= 0) music = 4;
		 }
	else if(PINB & 0x01 && !chatter) { 
	     printLcd(1, 1, t);
		 printLcd(1, 1, t);
		 stop = (stop + 1) % 2;
		 temm = Speaker;
		 Speaker = 0;
		 if(!stop) Speaker = temm;   
	     }
    if(!Speaker) musicKey = 100;
	if(Speaker) {switch (music) {
		case 0: musicKey = 100;
		case 1: {
	 		if(noteLength > 0) noteLength--;
			else if(musicNote < 119) {
				musicKey = soundofmusic[musicNote] >> 4;
				noteLength = 100 * (soundofmusic[musicNote] & 0x0f);
				musicNote++;
			}
			else musicKey = 100;
			if(musicNote == 140) {
				musicNote = 0;
		    	music = music+1;
				}
		} break;
		case 2: {
	 		if(noteLength > 0) noteLength--;
			else if(musicNote < 257) {
				musicKey = cityofstar[musicNote] >> 4;
				noteLength = 100 * (cityofstar[musicNote] & 0x0f);
				musicNote++;
			} else musicKey = 100;
			if(musicNote == 256) {
				musicNote = 0;
				music = music + 1;
			}
		} break;
	 	case 3: {
	 		if(noteLength > 0) noteLength--;
			else if(musicNote < 177) {
				musicKey = powerup[musicNote] >> 4;
			  	noteLength = 100 * (powerup[musicNote] & 0x0f);
			 	musicNote++;
			} else musicKey = 100;
			if(musicNote == 176) {
				musicNote = 0;
			  	music = music + 1;
			}
		} break;
			 case 4: {
	 			if(noteLength > 0) noteLength--;
				else if(musicNote < 77) {
					musicKey = londonsong[musicNote] >> 4;
					noteLength = 100 * (londonsong[musicNote] & 0x0f);
					musicNote++;
			} else musicKey = 100;
			if(musicNote == 76) {
				musicNote = 0;
				music = 1;
				}
			} break;
		}
	}
}


